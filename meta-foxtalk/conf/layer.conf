## meta-foxtalk/conf/layer.conf
```bitbake
BBPATH .= ":${LAYERDIR}"
BBFILES += "${LAYERDIR}/recipes-*/*/*.bb \
               ${LAYERDIR}/recipes-*/*/*.bbappend"
BBFILE_COLLECTIONS += "foxtalk"
BBFILE_PATTERN_foxtalk = "^${LAYERDIR}/"
BBFILE_PRIORITY_foxtalk = "7"
LAYERDEPENDS_foxtalk = "core"
LAYERSERIES_COMPAT_foxtalk = "scarthgap"
```

## meta-luckfox-bsp/conf/layer.conf
```bitbake
BBPATH .= ":${LAYERDIR}"
BBFILES += "${LAYERDIR}/recipes-*/*/*.bb \
			${LAYERDIR}/recipes-*/*/*.bbappend"
BBFILE_COLLECTIONS += "luckfox-bsp"
BBFILE_PATTERN_luckfox-bsp = "^${LAYERDIR}/"
BBFILE_PRIORITY_luckfox-bsp = "6"
LAYERDEPENDS_luckfox-bsp = "core"
LAYERSERIES_COMPAT_luckfox-bsp = "scarthgap"
```

## meta-luckfox-bsp/conf/machine/luckfox-pico-mini-b.conf
```bitbake
#@TYPE: Machine
#@NAME: Luckfox Pico Mini
#@Description: Luckfox Pico Mini with Rockhip RV1103G1

require conf/machine/include/arm/armv7a/tune-cortexa7.inc

MACHINE_FEATURES = "usbhost usbgadget wifi ext2"

PREFERRED_PROVIDER_virtual/kernel = "linux-luckfox"
PREFERRED_PROVIDER_virtual/bootloader = "u-boot-luckfox"

UBOOT_MACHINE = "luckfox_rv1106_uboot_defconfig"

SERIAL_CONSOLES = "1500000;ttyS0"

KERNEL_IMAGETYPE = "zImage"
KERNEL_DEVICETREE = "rv1103g-luckfox-pico-mini-b.dtb"

IMAGE_FSTYPES = "ext4"
```
